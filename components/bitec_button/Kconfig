## components/bitec_button/Kconfig
```kconfig
menu "Bitec Button Configuration"

    config BITEC_BUTTON_PIN
        int "Button GPIO"
        default 0
        help
            Set the button GPIO.

    config BITEC_BUTTON_DEBOUNCE_SHORT_TIME
        int "Short time"
        default 30
        help
        	Set short button press time in miliseconds.
        	
    config BITEC_BUTTON_DEBOUNCE_MEDIUM_TIME
        int "Medium time"
        default 3000
        help
        	Set medium button press time in miliseconds.
        	
    config BITEC_BUTTON_DEBOUNCE_LONG_TIME
        int "Long time"
        default 10000
        help
        	Set short button press time in miliseconds.

endmenu
```

## components/bitec_wifi/Kconfig
```kconfig
menu "bitec Wi-Fi Configuration"

    config BITEC_WIFI_POP_PIN
        string "Proof of possesion"
        help
            Proof of possesion string. This is relevant only for protocom security 1.

    config BITEC_WIFI_SSID_PREFIX
        string "SSID prefix"
        default "PROV_"
        help
        	AP SSID prefix. This is concatenated with the MAC number to build the AP SSID.

endmenu
```

## components/bl0937/Kconfig
```kconfig
menu "BL0937 single-phase electric energy metering"
	config BL0937_SEL_PIN
	    int "SEL GPIO Num"
	    default 11
	    help
	        GPIO number for BL0937 SEL pin.
	
	config BL0937_CF1_PIN
	    int "CF1 GPIO Num"
	    default 12
	    help
	        GPIO number for BL0937 CF1 pin.
	
	config BL0937_CF_PIN
	    int "CF GPIO Num"
	    default 13
	    help
	        GPIO number for BL0937 CF pin.
	        
	config BL0937_R_VOLTAGE
	    int "Net resistor"
	    default 1981
	    help
	        Resistor net value to measure voltage. To calculate this factor: Sum of upstream resistor plus downstream resistor.
	        
	config BL0937_R_CURRENT
	    int "Alloy resistor"
	    default 1
	    help
	        Alloy resistor value in miliohms to measure current.
	        
endmenu
```

## main/Kconfig.projbuild
```kconfig
menu "Application Configuration"

    config APPLICATION_FIRMWARE_UPG_URL
        string "Firmware Upgrade URL"
        default "https://firmware.digihome.technology:8444/firmware/get?"
        help
            URL of server which hosts the firmware image.

    config APPLICATION_FIRMWARE_UPGRADE_URL_FROM_STDIN
        bool
        default y if EXAMPLE_FIRMWARE_UPG_URL = "FROM_STDIN"
            
    config APPLICATION_DEVICE_ID
        string "ESP Device ID"
        default "fc97e0d4-1623-49e4-950f-3fb3594ea8ba"
        help
            ESP32-S2 device ID in UUID form.
            
    config APPLICATION_CONNECT_PUBLISHING_ENABLE
        bool "Enable MQTT connect publishing"
        default y
        help
            Enable the publish of a message to report a successful connection with the broker.

    config APPLICATION_CONNECT_PUBLISHING_TOPIC
        string "Connect topic"
        default "connected/"
        depends on APPLICATION_CONNECT_PUBLISHING_ENABLE
        help
            Set the topic for the publishing of successful connection messages.
            
    config APPLICATION_CONNECT_PUBLISHING_MESSAGE
        string "Connect message"
        default "connected"
        depends on APPLICATION_CONNECT_PUBLISHING_ENABLE
        help
            Set the message for the publishing of successful connection messages.

    config APPLICATION_USER_DEFINED_SUBSCRIPTION_1_ENABLE
        bool "Enable user defined subscription 1"
        default y
        help
            Enable user defined subscription 1. When MQTT is connected client will subscribe to this.

    config APPLICATION_USER_DEFINED_SUBSCRIPTION_1_TOPIC
        string "User defined subscription 1 topic"
        default "updates/"
        depends on APPLICATION_USER_DEFINED_SUBSCRIPTION_1_ENABLE
        help
            Set the topic for user defined subscription 1.
            
    config APPLICATION_USER_DEFINED_SUBSCRIPTION_2_ENABLE
        bool "Enable user defined subscription 2"
        default n
        help
            Enable user defined subscription 2. When MQTT is connected client will subscribe to this.

    config APPLICATION_USER_DEFINED_SUBSCRIPTION_2_TOPIC
        string "User defined subscription 2 topic"
        default "updates/"
        depends on APPLICATION_USER_DEFINED_SUBSCRIPTION_2_ENABLE
        help
            Set the topic for user defined subscription 2.

endmenu
```
